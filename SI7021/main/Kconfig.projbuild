## SI7021/main/Kconfig.projbuild
```kconfig
menu "Example Configuration"

config ADAFRUIT_SDA_PIN
    int "Number of the PIN connected to the I2C SDA"
	range 0 34
	default 23

config ADAFRUIT_SCL_PIN
    int "Number of the PIN connected to the I2C SDA"
	range 0 34
	default 22

endmenu
```
